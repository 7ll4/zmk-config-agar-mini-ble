## config/boards/shields/klink_kbd/Kconfig.defconfig
```kconfig
# Copyright (c) 2020 The ZMK Contributors
# SPDX-License-Identifier: MIT

config ZMK_KEYBOARD_NAME
    default "Agar Mini BLE"

config LED
    default y
```

## config/boards/shields/klink_kbd/boards/klink.conf
```kconfig
# All config for this keyboard
CONFIG_BUILD_OUTPUT_UF2_FAMILY_ID="0x59952840"
CONFIG_SPI=y

# USB Settings
CONFIG_ZMK_USB=y
CONFIG_USB_DEVICE_VID=0x9D5B
CONFIG_USB_DEVICE_PID=0x2561
CONFIG_USB_DEVICE_MANUFACTURER="KBDFans"
CONFIG_ZMK_KEYBOARD_NAME="Agar Mini BLE"

# BLE Settings
CONFIG_ZMK_BLE=y
CONFIG_BT_DEVICE_NAME_MAX=23
CONFIG_BT_DEVICE_NAME="Agar Mini BLE"
CONFIG_ZMK_BLE_EXPERIMENTAL_CONN=y
CONFIG_BT_CTLR_TX_PWR_PLUS_8=y

# Power Management (핵심 수정 부분)
# 딥 슬립(Deep Sleep)을 꺼서 깨우기 실패를 원천 차단합니다.
CONFIG_ZMK_SLEEP=n
# 1분(60,000ms) 동안 입력 없으면 저전력 Idle 모드 진입
# (블루투스 연결은 유지되므로 아무 키나 누르면 즉시 깨어납니다)
CONFIG_ZMK_IDLE_TIMEOUT=60000

# HID & Features
CONFIG_ZMK_HID_CONSUMER_REPORT_USAGES_FULL=y
CONFIG_ZMK_HID_GENERIC_DESKTOP_USAGES_BASIC=y
CONFIG_ZMK_POINTING=y
CONFIG_ZMK_HID_INDICATORS=y

# Debounce Settings
CONFIG_ZMK_KSCAN_DEBOUNCE_PRESS_MS=5
CONFIG_ZMK_KSCAN_DEBOUNCE_RELEASE_MS=5

# ZMK Studio Settings
CONFIG_ZMK_STUDIO_LOCKING=n
CONFIG_ZMK_STUDIO_LOCK_ON_DISCONNECT=n

# Power/LED Options
CONFIG_ZMK_EXT_POWER=n
# Soft Off는 전용 버튼이 없으므로 반드시 n으로 설정
CONFIG_ZMK_PM_SOFT_OFF=n
```
